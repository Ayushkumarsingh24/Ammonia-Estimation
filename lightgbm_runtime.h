#pragma once
// Minimal LightGBM tree evaluator for microcontrollers.
// Works with the headers generated by src/export_esp32.py
// (each defines Node, nodes[], tree_roots[], NUM_TREES in its own namespace).

#include <math.h>
#include <stdint.h>

namespace LightGBMRuntime {

inline float sigmoid(float x) {
    if (x >= 0.0f) {
        float z = expf(-x);
        return 1.0f / (1.0f + z);
    }
    float z = expf(x);
    return z / (1.0f + z);
}

inline float non_negative(float x) { return x < 0.0f ? 0.0f : x; }

// Sum of leaf values over all trees = LightGBM raw score.
// (LightGBM folds the initial average into the first tree's leaves.)
template <typename NodeT>
inline float raw_score(const NodeT* nodes, const int16_t* roots,
                       int num_trees, const float* x) {
    float sum = 0.0f;
    for (int t = 0; t < num_trees; t++) {
        int i = roots[t];
        while (!nodes[i].is_leaf) {
            float v = x[nodes[i].feature];
            bool go_left = isnan(v) ? (nodes[i].default_left != 0)
                                    : (v <= nodes[i].threshold);
            i = go_left ? nodes[i].left : nodes[i].right;
        }
        sum += nodes[i].value;
    }
    return sum;
}

}  // namespace LightGBMRuntime
